## Kconfig
```kconfig
menuconfig RADIO_CTRL
    bool "Custom Radio controller drivers"
    help
    Enable YourCo radio controller drivers (SX1262-based, etc).

if RADIO_CTRL
    config RADIO_CTRL_SX1262
        bool "DA SX1262 radio driver"
        depends on SPI && EVENTS
        default y if DT_HAS_YOURCO_SX1262_RADIO_ENABLED
        help
        Enable driver for SX1262-based radio using your custom API.
    config RADIO_CTRL_LOG_LEVEL
        int "Radio controller driver log level"
        default 2
        help
            Set the log level for the DANP module:
            0: Off
            1: Error
            2: Warning
            3: Info
            4: Debug
    config RADIO_CTRL_INIT_PRIORITY
        int "Radio controller driver init priority"
        default 90
        help
        Set the initialization priority for the radio controller driver.
    config RADIO_CTRL_MAX_MSG_SIZE
        int "Radio controller driver maximum message size"
        default 255
        help
        Set the maximum message size (in bytes) for the radio controller driver.
    config RADIO_CTRL_TIMEOUT_MS
        int "Radio controller driver timeout in milliseconds"
        default 1000
        help
        Set the timeout duration (in milliseconds) for radio operations.
    config RADIO_CTRL_RX_MSGQ_MAX_MSGS
        int "Radio controller driver maximum RX message queue size"
        default 10
        help
        Set the maximum number of messages in the RX message queue for the radio controller driver.
endif # RADIO_CTRL
```
